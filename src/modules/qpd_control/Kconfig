## src/modules/qpd_control/Kconfig
```kconfig
menuconfig MODULES_QPD_CONTROL
    bool "qpd_control"
    default n
    ---help---
        Enable qpd_control

menuconfig USER_qpd_control
    bool "qpd_control running as userspace module"
    default n
    depends on BOARD_PROTECTED && MODULES_QPD_CONTROL
```

## src/modules/quaternion_pd_controller/Kconfig
```kconfig
menuconfig MODULES_QUATERNION_PD_CONTROLLER
    bool "quaternion_pd_controller"
    default n
    ---help---
        Enable quaternion_pd_controller

menuconfig USER_QUATERNION_PD_CONTROLLER
    bool "quaternion_pd_controller running as userspace module"
    default n
    depends on BOARD_PROTECTED && MODULES_QUATERNION_PD_CONTROLLER
```
